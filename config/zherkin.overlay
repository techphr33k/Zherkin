// zherkin overlay

/ {
    kscan0: kscan0 {
        compatible = "zmk,kscan-gpio-matrix";
        diode-direction = "col2row";
        wakeup-source;



row-gpios = <&gpio0 24 (GPIO_ACTIVE_HIGH | GPIO_PULL_DOWN)>,
            <&gpio0 00 (GPIO_ACTIVE_HIGH | GPIO_PULL_DOWN)>,
			<&gpio0 11 (GPIO_ACTIVE_HIGH | GPIO_PULL_DOWN)>;

col-gpios = <&gpio0 31 GPIO_ACTIVE_HIGH>,
            <&gpio0 29 GPIO_ACTIVE_HIGH>,
			<&gpio0 02 GPIO_ACTIVE_HIGH>,
            <&gpio0 15 GPIO_ACTIVE_HIGH>,
			<&gpio0 13 GPIO_ACTIVE_HIGH>,
            <&gpio0 11 GPIO_ACTIVE_HIGH>,
			<&gpio0 10 GPIO_ACTIVE_HIGH>,
            <&gpio0 09 GPIO_ACTIVE_HIGH>,
			<&gpio0 06 GPIO_ACTIVE_HIGH>,
            <&gpio0 04 GPIO_ACTIVE_HIGH>;
};