## config/boards/shields/zherkin/Kconfig.shield
```kconfig
config SHIELD_ZHERKIN
    def_bool $(shields_list_contains,Zherkin)'
    select SHIELD_ZHERKIN
```

## config/west.yml
```yaml
manifest:
  remotes:
    - name: zmkfirmware
      url-base: https://github.com/zmkfirmware
    - name: techphr33k
      url-base: https://github.com/techphr33k
  projects:
    - name: zmk
      remote: zmkfirmware
      revision: main
      import: app/west.yml
  self:
    path: config
```
